## layers/meta-robot/conf/machine/raspberrypi0-w-robot.conf
```bitbake
require conf/machine/raspberrypi0-wifi.conf

RPI_KERNEL_DEVICETREE_OVERLAYS:remove = " \
    overlays/disable-bt.dtbo \
    overlays/disable-wifi.dtbo \
"
ENABLE_UART = "1"
ENABLE_UART0 = "1"
ENABLE_I2C = "1"
KMACHINE = "raspberrypi0-wifi"
KBUILD_DEFCONFIG = "bcmrpi_defconfig"

# Configuration de la console de debug UART
SERIAL_CONSOLES = "115200;ttyAMA0"
SERIAL_CONSOLES_CHECK = "ttyAMA0"

KERNEL_MODULE_AUTOLOAD:append = " i2c-bcm2835 i2c-dev"

RPI_EXTRA_CONFIG:append = "\n\
dtparam=i2c1=on\n\
dtparam=i2c_arm=on\n"
```

## layers/meta-robot/conf/machine/raspberrypi3-64-robot.conf
```bitbake
require conf/machine/raspberrypi3-64.conf

RPI_KERNEL_DEVICETREE_OVERLAYS:remove = " \
    overlays/disable-bt.dtbo \
    overlays/disable-wifi.dtbo \
"

KBUILD_DEFCONFIG:raspberrypi3-64-robot = "bcmrpi3_defconfig"
```
